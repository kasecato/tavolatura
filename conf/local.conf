## conf/local.conf
```bitbake
include "application.conf"

application.mode = DEV

db {
  default.url = "jdbc:mysql://127.0.0.1:13306/tavolatura?characterEncoding=utf8&verifyServerCertificate=false&useSSL=true"
  default.username = root
  default.password = sa
  default.logSql = true
}
```
